#include <SPI.h>
#include <LoRa.h>
#include <TinyGPS++.h>
#include <HardwareSerial.h>

// Bibliotecas para OLED Display
#include <Wire.h>
#include <Adafruit_GFX.h>
#include <Adafruit_SSD1306.h>

// Pinos para o LoRa
#define SCK 5
#define MISO 19
#define MOSI 27
#define SS 18
#define RST 14
#define DIO0 26

// Frequência do LoRa
#define BAND 915E6

// OLED pinos
#define OLED_SDA 4
#define OLED_SCL 15
#define OLED_RST 16
#define SCREEN_WIDTH 128
#define SCREEN_HEIGHT 64
#define LOGO_HEIGHT 64
#define LOGO_WIDTH 128
#define buzzer_pin 23

// Pino para receber dados do MPPT
#define MPPT_RX 16
HardwareSerial SerialMPPT(2);  // UART2 para o MPPT

// 'Captura de tela 2025-01-19 165250', 128x64px
const unsigned char epd_bitmap_Captura_de_tela_2025_01_19_165250[] PROGMEM = {
	0xff, 0xff, 0xff, 0xff, 0xff, 0xff, 0xff, 0xff, 0xff, 0xff, 0xff, 0xff, 0xff, 0xff, 0xff, 0xff, 
	0xff, 0xff, 0xff, 0xff, 0xff, 0xff, 0xff, 0x80, 0x7f, 0xff, 0xff, 0xff, 0xff, 0xff, 0xff, 0xff, 
	0xff, 0xff, 0xff, 0xff, 0xff, 0xff, 0xfc, 0x40, 0x1f, 0xfc, 0x03, 0xff, 0xff, 0xff, 0xff, 0xff, 
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	0xff, 0xff, 0xff, 0xff, 0xff, 0x18, 0x00, 0xf7, 0xf8, 0x07, 0xfc, 0xff, 0xfc, 0x7f, 0xff, 0xff

};

// Array de todos os bitmaps
const int epd_bitmap_allArray_LEN = 1;
const unsigned char* epd_bitmap_allArray[1] = {
    epd_bitmap_Captura_de_tela_2025_01_19_165250
};

// Configuração do GPS
#define GPSBaud 9600
TinyGPSPlus gps;
HardwareSerial serialGPS(1);  // UART1 para o GPS (pinos 3 e 17)

// OLED
Adafruit_SSD1306 display(SCREEN_WIDTH, SCREEN_HEIGHT, &Wire, OLED_RST);

// Contador de pacotes
int counter = 0;

// Variáveis para armazenar dados do MPPT
float correnteBateria = 0.0;
float tensaoBateria = 0.0;
float tensaoPainel = 0.0;
float potenciaPainel = 0.0;

void setup() {
  Serial.begin(115200);

  // Inicializar comunicação serial para o GPS
  serialGPS.begin(GPSBaud, SERIAL_8N1, 3, 17);
  Serial.println("UART do GPS inicializado!");

  // Inicializar comunicação serial para o MPPT
  SerialMPPT.begin(19200, SERIAL_8N1, MPPT_RX, -1);  // Pino 16 (RX), sem TX
  Serial.println("UART do MPPT inicializado!");

  // Configuração do buzzer
  pinMode(buzzer_pin, OUTPUT);
  digitalWrite(buzzer_pin, LOW);

  // Inicialização do OLED
  pinMode(OLED_RST, OUTPUT);
  digitalWrite(OLED_RST, LOW);
  delay(20);
  digitalWrite(OLED_RST, HIGH);

  Wire.begin(OLED_SDA, OLED_SCL);
  if (!display.begin(SSD1306_SWITCHCAPVCC, 0x3c, false, false)) {
    Serial.println(F("SSD1306 allocation failed"));
    for (;;);
  }

  // Exibir logo do Leviatã
  logoleviata();

  display.clearDisplay();
  display.setTextColor(WHITE);
  display.setTextSize(1);
  display.setCursor(0, 0);
  display.print("LORA SENDER");
  display.display();

  Serial.println("TELEMETRIA LEVIATA");

  // Inicialização do LoRa
  SPI.begin(SCK, MISO, MOSI, SS);
  LoRa.setPins(SS, RST, DIO0);

  if (!LoRa.begin(BAND)) {
    Serial.println("LoRa FALHOU!");
    while (1);
  }

  // Configuração da potência e Spreading Factor (SF)
  int potencia = 20;
  LoRa.setTxPower(potencia);
  int sf = 12;  // Spreading Factor entre 6 e 12
  LoRa.setSpreadingFactor(sf);
  Serial.print("Spreading Factor configurado para: ");
  Serial.println(sf);

  Serial.println("LoRa Sender iniciado!");
  Serial.print("Potência de transmissão configurada para: ");
  Serial.print(potencia);
  Serial.println(" dBm");

  display.setCursor(0, 10);
  display.println("LoRa INICIALIZADO OK!");
  display.display();
  delay(2000);
}

void loop() {
  // Ler dados do GPS
  while (serialGPS.available() > 0) {
    gps.encode(serialGPS.read());
  }

  // Variáveis para armazenar dados do GPS
  double latitude = 0.0;
  double longitude = 0.0;
  bool hasFix = false;

  if (gps.location.isUpdated()) {
    latitude = gps.location.lat();
    longitude = gps.location.lng();
    hasFix = true;
  }

  // Ler dados do MPPT
  if (SerialMPPT.available()) {
    String label = SerialMPPT.readStringUntil('\t');  // Ler o label do MPPT
    String val = SerialMPPT.readStringUntil('\r');    // Ler o valor do label

    if (label == "I") {  // Corrente da Bateria
      correnteBateria = val.toFloat() / 1000;  // Corrente em A
      Serial.print("Corrente da Bateria: ");
      Serial.print(correnteBateria);
      Serial.println(" A");
    } else if (label == "V") {  // Tensão da Bateria
      tensaoBateria = val.toFloat() / 1000;  // Tensão em V
      Serial.print("Tensão da Bateria: ");
      Serial.print(tensaoBateria);
      Serial.println(" V");
    } else if (label == "VPV") {  // Tensão do Painel
      tensaoPainel = val.toFloat() / 1000;  // Tensão em V
      Serial.print("Tensão do Painel: ");
      Serial.print(tensaoPainel);
      Serial.println(" V");
    } else if (label == "PPV") {  // Potência do Painel
      potenciaPainel = val.toFloat();  // Potência em W
      Serial.print("Potência do Painel: ");
      Serial.print(potenciaPainel);
      Serial.println(" W");
    }
  }

  // Preparar mensagem
  String message;
  if (hasFix) {
    message = "Packet: " + String(counter) +
              ", Lat: " + String(latitude, 6) +
              ", Lon: " + String(longitude, 6) +
              ", I: " + String(correnteBateria, 2) +
              ", V: " + String(tensaoBateria, 2) +
              ", VPV: " + String(tensaoPainel, 2) +
              ", PPV: " + String(potenciaPainel, 2);
    Serial.println("GPS fix available. Sending data.");
  } else {
    message = "Packet: " + String(counter) + ", No Data";
    Serial.println("No GPS fix. Sending No Data packet.");
  }

  // Enviar pacote LoRa
  LoRa.beginPacket();
  LoRa.print(message);
  LoRa.endPacket();
  
  digitalWrite(buzzer_pin, HIGH);
  delay(50);
  digitalWrite(buzzer_pin, LOW);

  // Atualizar Serial Monitor
  Serial.println("Sending packet: " + String(counter));
  Serial.println("Message: " + message);

  // Atualizar display OLED
  display.clearDisplay();
  display.setCursor(0, 0);
  display.println("LORA SENDER");
  display.setCursor(0, 20);
  display.print("LoRa packet sent.");
  display.setCursor(0, 30);
  display.print("Counter: ");
  display.print(counter);
  if (hasFix) {
    display.setCursor(0, 40);
    display.print("Lat: ");
    display.print(latitude, 6);
    display.setCursor(0, 50);
    display.print("Lon: ");
    display.print(longitude, 6);
  } else {
    display.setCursor(0, 40);
    display.println("No GPS Data");
  }
  display.display();

  counter++;
  delay(5000);  // Ajuste o delay conforme necessário
}

// Função para exibir a logo do Leviatã
void logoleviata(void) {
  display.clearDisplay();
  display.drawBitmap(
    (display.width() - LOGO_WIDTH) / 2,
    (display.height() - LOGO_HEIGHT) / 2,
    epd_bitmap_Captura_de_tela_2025_01_19_165250, LOGO_WIDTH, LOGO_HEIGHT, 1);
  display.display();
  delay(5000);
  display.invertDisplay(false);
}