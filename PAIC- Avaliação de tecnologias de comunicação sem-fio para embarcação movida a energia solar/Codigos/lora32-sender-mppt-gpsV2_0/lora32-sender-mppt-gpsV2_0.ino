#include <SPI.h>
#include <LoRa.h>
#include <TinyGPS++.h>
#include <SoftwareSerial.h>
#include <HardwareSerial.h>

// bibliotecas para OLED Display
#include <Wire.h>
#include <Adafruit_GFX.h>
#include <Adafruit_SSD1306.h>

// Pinos para o LoRa
#define SCK 5
#define MISO 19
#define MOSI 27
#define SS 18
#define RST 14
#define DIO0 26

// Lora frequencia
#define BAND 915E6

// OLED pinos
#define OLED_SDA 4
#define OLED_SCL 15
#define OLED_RST 16
#define SCREEN_WIDTH 128
#define SCREEN_HEIGHT 64
#define LOGO_HEIGHT   64
#define LOGO_WIDTH  128

#define buzzer_pin 23
#define MPPT_RX 36 // Pino RX para o MPPT
#define GPS_RX 34   // Pino RX para o GPS
#define GPS_TX 16   // Pino TX para o GPS
unsigned long lastUpdateTime = 0;  // Variável para controlar o tempo
unsigned long updateInterval = 1000;  // Intervalo de 1 segundo (1000 ms)
// Inicializações
TinyGPSPlus gps;
HardwareSerial serialGPS(1);
Adafruit_SSD1306 display(SCREEN_WIDTH, SCREEN_HEIGHT, &Wire, OLED_RST);

// 'Captura de tela 2025-01-19 165250', 128x64px
const unsigned char epd_bitmap_Captura_de_tela_2025_01_19_165250 [] PROGMEM = {
	0xff, 0xff, 0xff, 0xff, 0xff, 0xff, 0xff, 0xff, 0xff, 0xff, 0xff, 0xff, 0xff, 0xff, 0xff, 0xff, 
	0xff, 0xff, 0xff, 0xff, 0xff, 0xff, 0xff, 0x80, 0x7f, 0xff, 0xff, 0xff, 0xff, 0xff, 0xff, 0xff, 
	0xff, 0xff, 0xff, 0xff, 0xff, 0xff, 0xfc, 0x40, 0x1f, 0xfc, 0x03, 0xff, 0xff, 0xff, 0xff, 0xff, 
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	0xff, 0xff, 0xff, 0xff, 0xff, 0x18, 0x00, 0xf7, 0xf8, 0x07, 0xfc, 0xff, 0xfc, 0x7f, 0xff, 0xff
};

// Array of all bitmaps for convenience. (Total bytes used to store images in PROGMEM = 1040)
const int epd_bitmap_allArray_LEN = 1;
const unsigned char* epd_bitmap_allArray[1] = {
	epd_bitmap_Captura_de_tela_2025_01_19_165250
};


// Variáveis globais
int counter = 0;
float correnteBat = 0;
float tensaoBat = 0;
float tensaoPainel = 0;
float potenciaPainel = 0;

void setup() {
  Serial.begin(115200);
  serialGPS.begin(9600, SERIAL_8N1, GPS_RX, GPS_TX);
  Serial2.begin(19200, SERIAL_8N1, MPPT_RX, -1); // -1 indica não usar TX
  
  pinMode(buzzer_pin, OUTPUT);
  digitalWrite(buzzer_pin, LOW);

  // Inicialização do display OLED
  pinMode(OLED_RST, OUTPUT);
  digitalWrite(OLED_RST, LOW);
  delay(20);
  digitalWrite(OLED_RST, HIGH);
  
  Wire.begin(OLED_SDA, OLED_SCL);
  if(!display.begin(SSD1306_SWITCHCAPVCC, 0x3c, false, false)) {
    Serial.println(F("Falha no display OLED!"));
    while(1);
  }
  
  // Inicialização do LoRa
  SPI.begin(SCK, MISO, MOSI, SS);
  LoRa.setPins(SS, RST, DIO0);
  
  if (!LoRa.begin(BAND)) {
    Serial.println("Falha no LoRa!");
    display.println("Falha LoRa!");
    display.display();
    while(1);
  }
  
  // Configurações do LoRa
  LoRa.setTxPower(20);  // 20dBm
  LoRa.setSpreadingFactor(12);  // SF12
  
  // Mensagem inicial
  display.clearDisplay();
  display.setTextColor(WHITE);
  display.setTextSize(1);
  logoleviata();
  delay(3000);
  display.setCursor(0, 0);
  display.println("TELEMETRIA LEVIATA");
  display.println("Sistema Iniciado");
  display.display();
  
  // Buzzer de inicialização
  beep(2, 100);
  delay(2000);
}

void loop() {
  // 1. Coletar dados do MPPT
  lerDadosMPPT();
  
  // 2. Coletar dados do GPS
  bool gpsAtivo = false;
  double latitude = 0.0, longitude = 0.0;
  
  while(serialGPS.available() > 0) {
    if(gps.encode(serialGPS.read())) {
      if(gps.location.isValid()) {
        latitude = gps.location.lat();
        longitude = gps.location.lng();
        gpsAtivo = true;
      }
    }
  }

  // 3. Preparar pacote LoRa
  String pacoteLoRa = String(counter) + ",";
  
  if(gpsAtivo) {
    pacoteLoRa += String(latitude, 6) + "," + String(longitude, 6);
  } else {
    pacoteLoRa += "0,0"; // Sem dados GPS
  }
  
  // Adicionar dados MPPT ao pacote
  pacoteLoRa += "," + String(tensaoBat, 2) + ",";
  pacoteLoRa += String(correnteBat, 3) + ",";
  pacoteLoRa += String(tensaoPainel, 2) + ",";
  pacoteLoRa += String(potenciaPainel, 1);

  // 4. Enviar via LoRa
  LoRa.beginPacket();
  LoRa.print(pacoteLoRa);
  LoRa.endPacket();

  // 5. Atualizar display
  atualizarDisplay(gpsAtivo, latitude, longitude);

  // 6. Log no serial
  Serial.println("Enviado: " + pacoteLoRa);
  
  // 7. Controle de tempo
  counter++;
  delay(2000); // Espera 5 segundos
}
void lerDadosMPPT() {
  if(Serial2.available()) {
    String label = Serial2.readStringUntil('\t');
    String valor = Serial2.readStringUntil('\r\r\n');
    
    // Verifica se a leitura foi bem sucedida
      if(label == "V") {
        tensaoBat = valor.toFloat() / 1000;
      } 
      else if(label == "I") {
        correnteBat = valor.toFloat() / 1000;
      }
      else if(label == "VPV") {
        tensaoPainel = valor.toFloat() / 1000;
      }
      else if(label == "PPV") {
        potenciaPainel = valor.toFloat();
      } 
      static unsigned long prev_millis;
  }
}
void atualizarDisplay(bool gpsOk, double lat, double lon) {
  display.clearDisplay();
  display.setCursor(0, 0);
  display.println("TELEMETRIA LEVIATA");
  
  display.setCursor(0, 10);
  display.print("Pacote: ");
  display.println(counter);
  
  if(gpsOk) {
    display.setCursor(0, 20);
    display.print("Lat: ");
    display.println(lat, 6);
    display.setCursor(0, 30);
    display.print("Lon: ");
    display.println(lon, 6);
  } else {
    display.setCursor(0, 20);
    display.println("Aguardando GPS...");
  }
  
  // Dados MPPT
  display.setCursor(0, 40);
  display.print("Bat: ");
  display.print(tensaoBat, 2);
  display.print("V ");
  display.print(correnteBat, 2);
  display.println("A");
  
  display.setCursor(0, 50);
  display.print("Painel: ");
  display.print(tensaoPainel, 1);
  display.print("V ");
  display.print(potenciaPainel, 1);
  display.println("W");
  
  display.display();
}
void logoleviata(void) {
  // Limpa display
  display.clearDisplay();
  
  // Preenche tela com bitmap
  display.drawBitmap(
    (display.width()  - LOGO_WIDTH ) / 2,
    (display.height() - LOGO_HEIGHT) / 2,
    epd_bitmap_Captura_de_tela_2025_01_19_165250, LOGO_WIDTH, LOGO_HEIGHT, 1);
  // Exibe no display
  display.invertDisplay(true); 
  display.display();
  // Aguarda 1 s
  delay(5000);

  display.invertDisplay(false);

  digitalWrite(buzzer_pin, HIGH);
      delay(50);
      digitalWrite(buzzer_pin, LOW);

}
void beep(byte vezes, int tempo) {
  for(byte i=0; i<vezes; i++) {
    digitalWrite(buzzer_pin, HIGH);
    delay(tempo);
    digitalWrite(buzzer_pin, LOW);
    if(i < vezes-1) delay(tempo);
  }
}