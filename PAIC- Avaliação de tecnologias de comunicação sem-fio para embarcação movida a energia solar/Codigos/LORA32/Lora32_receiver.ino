  #include <SPI.h>
  #include <LoRa.h>
  #include <WiFi.h>
  #include <PubSubClient.h>

  // Libraries for OLED Display
  #include <Wire.h>
  #include <Adafruit_GFX.h>
  #include <Adafruit_SSD1306.h>

  // Define the pins used by the LoRa transceiver module
  #define SCK 5
  #define MISO 19
  #define MOSI 27
  #define SS 18
  #define RST 14
  #define DIO0 26

  // LoRa frequencia
  #define BAND 915E6

  // OLED pinos
  #define OLED_SDA 4
  #define OLED_SCL 15 
  #define OLED_RST 16
  #define SCREEN_WIDTH 128 // OLED display comprimento, em pixels
  #define SCREEN_HEIGHT 64 // OLED display altura, em pixels
  #define LOGO_HEIGHT   64
  #define LOGO_WIDTH  128

  #define buzzer_pin 23


const unsigned char epd_bitmap_Captura_de_tela_2025_01_19_163443 [] PROGMEM = {
	0xff, 0xff, 0xff, 0xff, 0xff, 0xff, 0xff, 0xff, 0xff, 0xff, 0xff, 0xff, 0xff, 0xff, 0xff, 0xff, 
	0xff, 0xff, 0xff, 0xff, 0xff, 0xff, 0xff, 0xff, 0xff, 0xff, 0xff, 0xff, 0xff, 0xff, 0xff, 0xff, 
	0xff, 0xff, 0xff, 0xff, 0xff, 0xff, 0xff, 0xff, 0xff, 0xff, 0xff, 0xff, 0xff, 0xff, 0xff, 0xff, 
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	0xff, 0xff, 0xff, 0xff, 0xff, 0xff, 0xff, 0xff, 0xff, 0xff, 0xff, 0xff, 0xff, 0xff, 0xff, 0xff
};
// Array of all bitmaps for convenience. (Total bytes used to store images in PROGMEM = 1040)
const int epd_bitmap_allArray_LEN = 1;
const unsigned char* epd_bitmap_allArray[1] = {
	epd_bitmap_Captura_de_tela_2025_01_19_163443
};

  Adafruit_SSD1306 display(SCREEN_WIDTH, SCREEN_HEIGHT, &Wire, OLED_RST);

  // WiFi & MQTT configuration
  const char* ssid = "UEA-EDU";  // WiFi
  const char* password = "12072022";  // senha do WiFi
  const char* mqttServer = "broker.hivemq.com";  // MQTT Broker endereço
  const int mqttPort = 1883;
  const char* mqttTopicSpeed = "Lora32/velocidade";  // MQTT topico para velocidade
  const char* mqttTopicRSSI = "Lora32/rssi";  // MQTT topico para RSSI
  const char* mqttTopicLostPackets = "Lora32/pacotes_perdidos";
  const char* mqttTopicPacote = "Lora32/pacote"; // MQTT topico para perda de pacotes
  // Mqtt topicos do mppt
  const char* mqttTopicCorrenteBateria = "Lora32/CorrenteBat";
  const char* mqttTopicTensãoBateria = "Lora32/TensãoBat";
  const char* mqttTopicTensãoPV = "Lora32/TensãoPV";
  const char* mqttTopicPotênciaPV = "Lora32/PotenciaPV"
  

  WiFiClient wifiClient;
  PubSubClient mqttClient(wifiClient);

  // Varaiveis Lora e dados
  String LoRaData;
  int rssi = 0; // RSSI
  float speed = 0.0;  // Placeholder for speed data
  int packetCountReceived = 0; // Number of received packets
  int packetCountLost = 0;     // Number of lost packets
  int lastPacketReceived = 0;  // Last received packet number

  void setup() { 
    // Initialize Serial Monitor
    Serial.begin(115200);

    // Initialize OLED display
    pinMode(OLED_RST, OUTPUT);
    digitalWrite(OLED_RST, LOW);
    delay(20);
    digitalWrite(OLED_RST, HIGH);
    Wire.begin(OLED_SDA, OLED_SCL);
    if (!display.begin(SSD1306_SWITCHCAPVCC, 0x3c, false, false)) {
      Serial.println(F("SSD1306 allocation failed"));
      for (;;);  // Loop forever
    }

   

    // Connect to WiFi
    WiFi.begin(ssid, password);
    while (WiFi.status() != WL_CONNECTED) {
      delay(1000);
      Serial.println("Connecting to WiFi...");
    }
    Serial.println("Connected to WiFi!");


   logoleviata();

    display.clearDisplay();
    display.setTextColor(WHITE);
    display.setTextSize(1);
    display.setCursor(0, 0);
    display.println("LORA RECEIVER");
    display.print("wifi conectado");
    display.display();


    // Initialize MQTT client
    mqttClient.setServer(mqttServer, mqttPort);

    // Initialize LoRa module
    SPI.begin(SCK, MISO, MOSI, SS);
    LoRa.setPins(SS, RST, DIO0);
    if (!LoRa.begin(BAND)) {
      Serial.println("LoRa initialization failed!");
      while (1);
    }
    Serial.println("LoRa Initialized!");

    display.setCursor(0, 20);
    display.println("LoRa Initialized!");
    display.display();
  
  // DEFINIÇÃO DA POTENCIA-----------------  
  int potencia = 20;
    LoRa.setTxPower(potencia);
  // Configurar Spreading Factor (SF)
  int sf = 12; // Alterar para valores entre 6 e 12
    LoRa.setSpreadingFactor(sf);
    Serial.print("Fator de espalhamento configurado para: ");
    Serial.println(sf);
    pinMode(buzzer_pin, OUTPUT);
    digitalWrite(buzzer_pin, LOW);

  }

  void loop() {
    // Connect to MQTT if not already connected
    if (!mqttClient.connected()) {
      reconnectMQTT();
    }
    mqttClient.loop();

    // Check for LoRa packet
    int packetSize = LoRa.parsePacket();
    if (packetSize) {
      // Receive data from LoRa
      Serial.print("Received packet: ");
      digitalWrite(buzzer_pin, HIGH);
      delay(50);
      digitalWrite(buzzer_pin, LOW);
      while (LoRa.available()) {
        LoRaData = LoRa.readString();
        Serial.print(LoRaData);
       

      }
      // Get RSSI value of the packet
      rssi = LoRa.packetRssi();
      Serial.print(" with RSSI ");
      Serial.println(rssi);

      // Convert LoRa data to float for speed (example: parse speed from string)
      speed = LoRaData.toFloat();

      // Extract the packet number from the data (assumes packets are sequentially numbered)
      int packetNumber = LoRaData.substring(8).toInt(); // "Pacote #" tem 8 caracteres

      // Update received packet count and lost packet count
      if (packetNumber == lastPacketReceived + 1) {
        packetCountReceived++;
        lastPacketReceived = packetNumber;
        
      } else {
        int lostPackets = packetNumber - lastPacketReceived - 1;
        packetCountLost += lostPackets;
        lastPacketReceived = packetNumber;
      }

      // Publish speed, RSSI, and lost packets to separate MQTT topics
      mqttClient.publish(mqttTopicSpeed, String(speed).c_str());
      mqttClient.publish(mqttTopicRSSI, String(rssi).c_str());
      mqttClient.publish(mqttTopicLostPackets, String(packetCountLost).c_str());
      mqttClient.publish(mqttTopicPacote, String(packetNumber).c_str());

      // Display data on OLED
      display.clearDisplay();
      display.setCursor(0, 0);
      display.print("LORA RECEIVER");
      display.setCursor(0, 20);
      display.print("Velocidade: ");
      display.print(speed);
      display.s.çtCursor(0, 30);
      display.print("RSSI: ");
      display.print(rssi);
      display.setCursor(0, 40);
      display.print("Perda Pacotes: ");
      display.print(packetCountLost);
      display.display();
    }
  }

  // Function to reconnect to MQTT if disconnected
  void reconnectMQTT() {
    while (!mqttClient.connected()) {
      Serial.println("Attempting MQTT connection...");
      if (mqttClient.connect("LoraReceiverClient")) {
        Serial.println("Connected to MQTT!");
      } else {
        Serial.print("Failed, rc=");
        Serial.print(mqttClient.state());
        delay(5000);
      }
    }
  }

void logoleviata(void) {
  // Limpa display
  display.clearDisplay();
  
  // Preenche tela com bitmap
  display.drawBitmap(
    (display.width()  - LOGO_WIDTH ) / 2,
    (display.height() - LOGO_HEIGHT) / 2,
    epd_bitmap_Captura_de_tela_2025_01_19_163443, LOGO_WIDTH, LOGO_HEIGHT, 1);
  // Exibe no display
  display.invertDisplay(true); 
  display.display();
  // Aguarda 1 s
  delay(5000);

  display.invertDisplay(false);

}