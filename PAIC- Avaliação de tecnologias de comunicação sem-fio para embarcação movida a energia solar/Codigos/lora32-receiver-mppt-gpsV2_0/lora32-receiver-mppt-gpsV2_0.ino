#include <SPI.h>
#include <LoRa.h>
#include <WiFi.h>
#include <PubSubClient.h>
#include <Adafruit_NeoPixel.h>
#include <Wire.h>

//bibliotecas para oled
#include <Adafruit_GFX.h>
#include <Adafruit_SSD1306.h>

// pinos para o LoRa
#define SCK 5
#define MISO 19
#define MOSI 27
#define SS 18
#define RST 14
#define DIO0 26
// LoRa frequencia
#define BAND 915E6

// OLED pinos
#define OLED_SDA 4
#define OLED_SCL 15 
#define OLED_RST 16
#define SCREEN_WIDTH 128
#define SCREEN_HEIGHT 64
//neopixel oled
#define NEOPIXEL_PIN 13
#define NUMPIXELS 16

const unsigned char epd_bitmap_Captura_de_tela_2025_01_19_163443 [] PROGMEM = {
	0xff, 0xff, 0xff, 0xff, 0xff, 0xff, 0xff, 0xff, 0xff, 0xff, 0xff, 0xff, 0xff, 0xff, 0xff, 0xff, 
	0xff, 0xff, 0xff, 0xff, 0xff, 0xff, 0xff, 0xff, 0xff, 0xff, 0xff, 0xff, 0xff, 0xff, 0xff, 0xff, 
	0xff, 0xff, 0xff, 0xff, 0xff, 0xff, 0xff, 0xff, 0xff, 0xff, 0xff, 0xff, 0xff, 0xff, 0xff, 0xff, 
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	0xff, 0xff, 0xff, 0xff, 0xff, 0xff, 0xff, 0xff, 0xff, 0xff, 0xff, 0xff, 0xff, 0xff, 0xff, 0xff
};
// Array of all bitmaps for convenience. (Total bytes used to store images in PROGMEM = 1040)
const int epd_bitmap_allArray_LEN = 1;
const unsigned char* epd_bitmap_allArray[1] = {
	epd_bitmap_Captura_de_tela_2025_01_19_163443
};


// Objetos
Adafruit_SSD1306 display(SCREEN_WIDTH, SCREEN_HEIGHT, &Wire, OLED_RST);
Adafruit_NeoPixel pixels(NUMPIXELS, NEOPIXEL_PIN, NEO_GRB + NEO_KHZ800);

// Configurações WiFi e MQTT
const char* ssid = "LEVIATÃ_UEA_23";
const char* password = "PORAQUE_23";
const char* mqttServer = "test.mosquitto.org";
const int mqttPort = 1883;

// Tópicos MQTT
const char* mqttTopicGPS = "Lora32/gps";
const char* mqttTopicRSSI = "Lora32/rssi";
const char* mqttTopicPacote = "Lora32/pacote";
const char* mqttTopicTensaoBat = "Lora32/TensaoBat";
const char* mqttTopicCorrenteBat = "Lora32/CorrenteBat";
const char* mqttTopicTensaoPV = "Lora32/TensaoPV";
const char* mqttTopicPotenciaPV = "Lora32/PotenciaPV";

WiFiClient wifiClient;
PubSubClient mqttClient(wifiClient);

// Variáveis
String LoRaData;
int rssi = 0;
int packetCountReceived = 0;
int packetCountLost = 0;
int lastPacketReceived = 0;

// Variáveis para armazenar dados
int contador = 0;
double latitude = 0.0;
double longitude = 0.0;
float tensaoBat = 0.0;
float correnteBat = 0.0;
float tensaoPainel = 0.0;
float potenciaPainel = 0.0;

void setup() {
  Serial.begin(115200);

  // Inicializa NeoPixel
  pixels.begin();
  pixels.show();

  // Inicializa OLED
  pinMode(OLED_RST, OUTPUT);
  digitalWrite(OLED_RST, LOW);
  delay(20);
  digitalWrite(OLED_RST, HIGH);
  Wire.begin(OLED_SDA, OLED_SCL);
  if (!display.begin(SSD1306_SWITCHCAPVCC, 0x3c, false, false)) {
    Serial.println(F("Falha no display OLED!"));
    for(;;);
  }

  // Conecta WiFi
  WiFi.begin(ssid, password);
  while (WiFi.status() != WL_CONNECTED) {
    delay(1000);
    Serial.println("Conectando ao WiFi...");
  }
  Serial.println("Conectado ao WiFi!");

  // Mostra logo
  logoleviata();
  delay(3000);

  display.clearDisplay();
  display.setTextColor(WHITE);
  display.setTextSize(1);
  display.setCursor(0, 0);
  display.println("LORA RECEIVER");
  display.print("WiFi conectado");
  display.display();
  pixels.setBrightness(50);

  // Configura MQTT
  mqttClient.setServer(mqttServer, mqttPort);

  // Inicializa LoRa
  SPI.begin(SCK, MISO, MOSI, SS);
  LoRa.setPins(SS, RST, DIO0);
  if (!LoRa.begin(BAND)) {
    Serial.println("Falha na inicialização do LoRa!");
    while(1);
  }
  Serial.println("LoRa inicializado!");

  display.setCursor(0, 20);
  display.println("LoRa inicializado!");
  display.display();
  
  // Configurações LoRa
  LoRa.setTxPower(20);
  LoRa.setSpreadingFactor(12);
}

void loop() {
  if (!mqttClient.connected()) {
    reconnectMQTT();
  }
  mqttClient.loop();

  int packetSize = LoRa.parsePacket();
  if (packetSize) {
    Serial.print("Pacote recebido: ");
    while (LoRa.available()) {
      LoRaData = LoRa.readString();
      Serial.println(LoRaData);
    }
    
    rssi = LoRa.packetRssi();
    Serial.print("RSSI: ");
    Serial.println(rssi);

    // Atualiza LEDs com RSSI
    updateRssiBar(rssi);

    // Processa os dados recebidos
    if (processarDados(LoRaData)) {
      // Publica dados no MQTT
      publicarDadosMQTT();
      
      // Atualiza display
      atualizarDisplay();
    }
  }
}

bool processarDados(String data) {
  // Formato esperado: contador,latitude,longitude,tensaoBat,correnteBat,tensaoPainel,potenciaPainel
  int separadores[6]; // Armazena posições das vírgulas
  int index = 0;
  
  // Encontra as vírgulas
  for (int i = 0; i < data.length(); i++) {
    if (data.charAt(i) == ',') {
      separadores[index] = i;
      index++;
      if (index >= 6) break;
    }
  }
  
  // Verifica se encontramos todas as vírgulas
  if (index < 6) {
    Serial.println("Formato de dados inválido!");
    return false;
  }

  // Extrai os valores
  contador = data.substring(0, separadores[0]).toInt();
  latitude = data.substring(separadores[0]+1, separadores[1]).toFloat();
  longitude = data.substring(separadores[1]+1, separadores[2]).toFloat();
  tensaoBat = data.substring(separadores[2]+1, separadores[3]).toFloat();
  correnteBat = data.substring(separadores[3]+1, separadores[4]).toFloat();
  tensaoPainel = data.substring(separadores[4]+1, separadores[5]).toFloat();
  potenciaPainel = data.substring(separadores[5]+1).toFloat();

  // Controle de pacotes perdidos
  if (contador == lastPacketReceived + 1) {
    packetCountReceived++;
  } else if (contador > lastPacketReceived + 1) {
    packetCountLost += (contador - lastPacketReceived - 1);
  }
  lastPacketReceived = contador;

  return true;
}

void publicarDadosMQTT() {
  // Publica dados GPS
  String gpsData = String(latitude, 6) + "," + String(longitude, 6);
  mqttClient.publish(mqttTopicGPS, gpsData.c_str());
  
  // Publica mppt
  mqttClient.publish(mqttTopicTensaoBat, String(tensaoBat).c_str());
  mqttClient.publish(mqttTopicCorrenteBat, String(correnteBat).c_str());
  mqttClient.publish(mqttTopicTensaoPV, String(tensaoPainel).c_str());
  mqttClient.publish(mqttTopicPotenciaPV, String(potenciaPainel).c_str());  
  
  // Publica RSSI e contagem de pacotes
  mqttClient.publish(mqttTopicRSSI, String(rssi).c_str());
  mqttClient.publish(mqttTopicPacote, String(contador).c_str());
}

void atualizarDisplay() {
  display.clearDisplay();
  display.setTextColor(WHITE);
  display.setTextSize(1);
  display.setCursor(0, 0);
  display.println("TELEMETRIA LEVIATA");
  
  display.setCursor(0, 10);
  display.print("Pacote: ");
  display.println(contador);
  
  display.setCursor(0, 20);
  display.print("Lat: ");
  display.print(latitude, 6);
  display.setCursor(0, 30);
  display.print("Lon: ");
  display.print(longitude, 6);
  
  display.setCursor(0, 40);
  display.print("Bat: ");
  display.print(tensaoBat, 2);
  display.print("V ");
  display.print(correnteBat, 2);
  display.println("A");
  
  display.setCursor(0, 50);
  display.print("Painel: ");
  display.print(tensaoPainel, 1);
  display.print("V ");
  display.print(potenciaPainel, 1);
  display.println("W");
  
  display.display();
}

void updateRssiBar(int rssiValue) {
  // Mapeia RSSI para número de LEDs (-120 a -50)
  int numLeds = map(rssiValue, -120, -50, 1, NUMPIXELS);
  numLeds = constrain(numLeds, 0, NUMPIXELS);
  
  pixels.clear();
  
  for(int i=0; i<numLeds; i++) {
    if(i < NUMPIXELS/3) {
      pixels.setPixelColor(i, pixels.Color(255, 0, 0)); // Vermelho
    } else if(i < 2*NUMPIXELS/3) {
      pixels.setPixelColor(i, pixels.Color(255, 255, 0)); // Amarelo
    } else {
      pixels.setPixelColor(i, pixels.Color(0, 255, 0)); // Verde
    }
  }
  
  pixels.show();
}

void reconnectMQTT() {
  while (!mqttClient.connected()) {
    Serial.println("Conectando ao MQTT...");
    if (mqttClient.connect("LoraReceiverClient")) {
      Serial.println("Conectado ao MQTT!");
    } else {
      Serial.print("Falha, rc=");
      Serial.print(mqttClient.state());
      delay(5000);
    }
  }
}

void logoleviata(void) {
  display.clearDisplay();
  display.drawBitmap(
    (display.width() - 128) / 2,
    (display.height() - 64) / 2,
    epd_bitmap_Captura_de_tela_2025_01_19_163443, 128, 64, 1);
  display.invertDisplay(true); 
  display.display();
  delay(5000);
  display.invertDisplay(false);
}